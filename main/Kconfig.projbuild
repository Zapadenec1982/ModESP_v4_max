## main/Kconfig.projbuild
```kconfig
menu "ModESP Configuration"
    choice MODESP_BOARD
        prompt "Target board"
        default MODESP_BOARD_DEV
        help
            Select the target hardware board.
            This determines which board.json and bindings.json
            are copied to data/ during build.

        config MODESP_BOARD_DEV
            bool "Dev Board (GPIO relays)"

        config MODESP_BOARD_KC868A6
            bool "KC868-A6 (I2C PCF8574)"
    endchoice

    config MODESP_BOARD_DIR
        string
        default "dev"       if MODESP_BOARD_DEV
        default "kc868a6"   if MODESP_BOARD_KC868A6

    choice MODESP_CLOUD_BACKEND
        prompt "Cloud backend"
        default MODESP_CLOUD_MQTT
        help
            Select the cloud communication backend.
            MQTT: self-hosted Mosquitto broker (default).
            AWS: AWS IoT Core with mTLS, Device Shadow, IoT Jobs.

        config MODESP_CLOUD_MQTT
            bool "Mosquitto (self-hosted MQTT)"

        config MODESP_CLOUD_AWS
            bool "AWS IoT Core"
    endchoice

    config MODESP_MQTT_DEFAULT_BROKER
        string "Default MQTT broker URL"
        default "mqtts://modesp.com.ua"
        depends on MODESP_CLOUD_MQTT
        help
            Fallback MQTT broker when NVS is empty (after full reflash).
            Used by MqttService when broker is not configured in NVS.

    config MODESP_MQTT_DEFAULT_PORT
        int "Default MQTT broker port"
        default 8883
        depends on MODESP_CLOUD_MQTT
        help
            Fallback MQTT port when NVS is empty.

    config MODESP_MQTT_BOOTSTRAP_PASSWORD
        string "Bootstrap MQTT password"
        default ""
        depends on MODESP_CLOUD_MQTT
        help
            Shared bootstrap password for initial MQTT connection.
            Must match MQTT_BOOTSTRAP_PASSWORD in cloud .env.
            Only grants access to pending namespace (minimal privilege).
    config MODESP_MODBUS_ENABLED
        bool "Enable Modbus RTU Slave (RS-485)"
        default n
        help
            Enables Modbus RTU Slave on UART1 via RS-485 (KC868-A6).
            Register map auto-generated from module manifests.
            Adds ~15KB RAM, ~23KB Flash.

    config MODESP_ZONE_COUNT
        int "Number of refrigeration zones"
        default 1
        range 1 4
        help
            Number of independent refrigeration zones per controller.
            1 = single zone (default, backward compatible).
            2-4 = multi-zone: separate thermostat/defrost/EEV per zone,
            shared compressor and condenser fan.
            Each zone adds ~10KB RAM (module instances + state keys).
            Requires per-zone bindings in bindings.json.
endmenu
```
